/dts-v1/;
/plugin/;

/ {
    compatible = "xunlong,orangepi-zero2w";

    fragment@0 {
        target-path = "/soc/serial@5000800";
        __overlay__ {
            // Use with the patched kernel only. Other UARTs retain their binding.
            compatible = "allwinner,sun50i-h616-uart";
        };
    };
};
